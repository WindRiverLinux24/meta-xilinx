## meta-xilinx-mali400/conf/layer.conf
```bitbake
# We have a conf and classes directory, add to BBPATH
BBPATH .= ":${LAYERDIR}"

# We have a packages directory, add to BBFILES
BSP_XILINX_DERIVED ??= ""
BBFILES += "${@bb.utils.contains_any('MACHINE', '${BSP_XILINX_DERIVED}', '${LAYERDIR}/recipes-*/*/*.bb', '', d)}"
BBFILES += "${@bb.utils.contains_any('MACHINE', '${BSP_XILINX_DERIVED}', '${LAYERDIR}/recipes-*/*/*.bbappend', '', d)}"

BBFILES_DYNAMIC += " \
    openembedded-layer:${LAYERDIR}/dynamic-layers/openembedded-layer/recipes-*/*/*.bb \
    openembedded-layer:${LAYERDIR}/dynamic-layers/openembedded-layer/recipes-*/*/*.bbappend \
    qt5-layer:${LAYERDIR}/dynamic-layers/qt5-layer/recipes-*/*/*.bb \
    qt5-layer:${LAYERDIR}/dynamic-layers/qt5-layer/recipes-*/*/*.bbappend \
    xilinx-multimedia:${LAYERDIR}/dynamic-layers/xilinx-multimedia/recipes-*/*/*.bb \
    xilinx-multimedia:${LAYERDIR}/dynamic-layers/xilinx-multimedia/recipes-*/*/*.bbappend \
"

BBFILE_COLLECTIONS += "xilinx-mali400"
BBFILE_PATTERN_xilinx-mali400 = "^${LAYERDIR}/"
BBFILE_PRIORITY_xilinx-mali400 = "5"

LAYERDEPENDS_xilinx-mali400 = " \
    core \
    xilinx \
    "

LAYERSERIES_COMPAT_xilinx-mali400 = "scarthgap"

INHERIT += "${@bb.utils.contains_any('MACHINE', '${BSP_XILINX_DERIVED}', 'sanity-meta-xilinx-mali400', '', d)}"

META_XILINX_MALI400_CONFIG_PATH = "${LAYERDIR}/conf/distro/include/meta-xilinx-mali400-default-versions.inc"

USER_CLASSES:append = " meta-xilinx-mali400-cfg"

BBMASK += "${LAYERDIR}/recipes-devtools/qemu/"
BBMASK += "${LAYERDIR}/recipes-kernel/linux/"
BBMASK += "${@bb.utils.contains_any('MACHINE_FEATURES', 'mali400', '', '${LAYERDIR}/recipes-graphics/', d)}"
BBMASK += "${@bb.utils.contains_any('MACHINE_FEATURES', 'mali400', '', '${LAYERDIR}/recipes-gnome/', d)}"
```

## meta-xilinx-standalone/conf/layer.conf
```bitbake
# We have a conf and classes directory, add to BBPATH
BBPATH .= ":${LAYERDIR}"

# We have recipes-* directories, add to BBFILES
BSP_XILINX_DERIVED ??= ""
BBFILES += "${@bb.utils.contains_any('MACHINE', '${BSP_XILINX_DERIVED}', '${LAYERDIR}/recipes-*/*/*.bb', '', d)}"
BBFILES += "${@bb.utils.contains_any('MACHINE', '${BSP_XILINX_DERIVED}', '${LAYERDIR}/recipes-*/*/*.bbappend', '', d)}"
BBFILES += "${@bb.utils.contains_any('MACHINE', '${BSP_XILINX_DERIVED}', '${LAYERDIR}/recipes-*/*.bb', '', d)}"
BBFILES += "${@bb.utils.contains_any('MACHINE', '${BSP_XILINX_DERIVED}', '${LAYERDIR}/recipes-*/*.bbappend', '', d)}"

BBFILE_COLLECTIONS += "xilinx-standalone"
BBFILE_PATTERN_xilinx-standalone = "^${LAYERDIR}/"
BBFILE_PRIORITY_xilinx-standalone = "7"

LAYERDEPENDS_xilinx-standalone = "core xilinx"
LAYERRECOMMENDS_xilinx-standalone = "xilinx-microblaze"

LAYERSERIES_COMPAT_xilinx-standalone = "scarthgap"

PREFERRED_VERSION_plm-firmware ?= "${@d.getVar("XILINX_RELEASE_VERSION").replace('v','')}%"
PREFERRED_VERSION_psm-firmware ?= "${@d.getVar("XILINX_RELEASE_VERSION").replace('v','')}%"
PREFERRED_VERSION_pmu-firmware ?= "${@d.getVar("XILINX_RELEASE_VERSION").replace('v','')}%"
PREFERRED_VERSION_fsbl-firmware ?= "${@d.getVar("XILINX_RELEASE_VERSION").replace('v','')}%"
```
